## main/Kconfig.projbuild
```kconfig
menu "Wifi Configuration"
    config ESP_WIFI_SSID
        string "WiFi SSID"
        default "my ssid"
        help
            SSID (network name) for the example to connect to.

    config ESP_WIFI_PASSWORD
        string "WiFi Password"
        default "my password"
        help
            WiFi password (WPA or WPA2) for the example to use.

endmenu

menu "MQTT Configuration"
        config BROKER_URL
        string "Broker URL"
        default "my mqtt broker url"
        help
            URL of the broker to connect to
endmenu
```
